## sdkconfig.defaults
```kconfig
CONFIG_AUTOSTART_ARDUINO=y
# CONFIG_WS2812_LED_ENABLE is not set
CONFIG_FREERTOS_HZ=1000
CONFIG_MBEDTLS_PSK_MODES=y
CONFIG_MBEDTLS_KEY_EXCHANGE_PSK=y

#
# Arduino TinyUSB
#
CONFIG_TINYUSB_ENABLED=y

#
# Serial (CDC) driver
#
CONFIG_TINYUSB_CDC_ENABLED=y
CONFIG_TINYUSB_DESC_CDC_STRING="Espressif CDC Device"
CONFIG_TINYUSB_CDC_RX_BUFSIZE=64
CONFIG_TINYUSB_CDC_TX_BUFSIZE=64
# end of Serial (CDC) driver

#
# Mass Storage (MSC) driver
#
CONFIG_TINYUSB_MSC_ENABLED=y
CONFIG_TINYUSB_DESC_MSC_STRING="Espressif MSC Device"
CONFIG_TINYUSB_MSC_BUFSIZE=4096
# end of Mass Storage (MSC) driver

#
# Human Interface (HID) driver
#
CONFIG_TINYUSB_HID_ENABLED=y
CONFIG_TINYUSB_DESC_HID_STRING="Espressif HID Device"
CONFIG_TINYUSB_HID_BUFSIZE=64
# end of Human Interface (HID) driver

#
# MIDI driver
#
CONFIG_TINYUSB_MIDI_ENABLED=y
CONFIG_TINYUSB_DESC_MIDI_STRING="Espressif MIDI Device"
CONFIG_TINYUSB_MIDI_RX_BUFSIZE=64
CONFIG_TINYUSB_MIDI_TX_BUFSIZE=64
# end of MIDI driver

#
# VIDEO driver
#
CONFIG_TINYUSB_VIDEO_ENABLED=y
CONFIG_TINYUSB_DESC_VIDEO_STRING="Espressif VIDEO Device"
CONFIG_TINYUSB_VIDEO_STREAMING_BUFSIZE=64
CONFIG_TINYUSB_VIDEO_STREAMING_IFS=1
# end of VIDEO driver

#
# DFU Runtime driver
#
CONFIG_TINYUSB_DFU_RT_ENABLED=y
CONFIG_TINYUSB_DESC_DFU_RT_STRING="Espressif DFU_RT Device"
# end of DFU Runtime driver

#
# VENDOR driver
#
CONFIG_TINYUSB_VENDOR_ENABLED=y
CONFIG_TINYUSB_DESC_VENDOR_STRING="Espressif VENDOR Device"
CONFIG_TINYUSB_VENDOR_RX_BUFSIZE=64
CONFIG_TINYUSB_VENDOR_TX_BUFSIZE=64
# end of VENDOR driver

CONFIG_TINYUSB_DEBUG_LEVEL=0
# end of Arduino TinyUSB
```
